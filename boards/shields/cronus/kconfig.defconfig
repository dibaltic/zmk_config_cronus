## boards/shields/cronus/kconfig.defconfig
```kconfig
if SHIELD_CRONUS_LEFT

# Name must be less than 16 characters long!
config ZMK_KEYBOARD_NAME
    default "Cronus"

config ZMK_SPLIT_ROLE_CENTRAL
    default y

endif

if SHIELD_CRONUS_LEFT || SHIELD_CRONUS_RIGHT

config ZMK_SPLIT
    default y

endif
```

## boards/shields/cronus/kconfig.shield
```kconfig
# No whitespace after the comma or in your part name!
config SHIELD_CRONUS_LEFT
    def_bool $(shields_list_contains,cronus_left)

# No whitespace after the comma or in your part name!
config SHIELD_CRONUS_RIGHT
    def_bool $(shields_list_contains,cronus_right)
```
